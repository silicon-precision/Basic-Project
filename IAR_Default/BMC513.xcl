//   Revision control system
//       $Id: lnk51ew.xcl 1.9 2004/02/11 17:17:04Z owi Exp $

// Segment limits
// --------------
// DATA Segment definition.
-D_BIT_START=0				// start bit address for memory.
-D_BIT_END=7F				// end bit address for memory.

-D_BDATA_START=20			// start address for BDATA memory.
-D_BDATA_END=2F			// end address for BDATA memory.

-D_DATA_START=30			// start address for DATA memory.
-D_DATA_END=7F				// end address for DATA memory.

-D_IDATA_START=30			// start address for IDATA memory.
-D_IDATA_END=FF			// end address for IDATA memory.

-D_PDATA_START=8000			// start address for PDATA memory.(256-byte)
-D_PDATA_END=80FF			// end address for PDATA memory.(256-byte)

-D_XDATA_START=8000            // First address of xdata memory.
-D_XDATA_END=8FFF              // Last address of xdata memory.

-D_IXDATA_START=_XDATA_START	// First address of on chip XDATA memory.
-D_IXDATA_END=_XDATA_END		// Last address of on chip XDATA memory.

-D_XDATA_Z_START=_XDATA_START	// First address of on chip XDATA memory.
-D_XDATA_Z_END=_XDATA_END	// Last address of on chip XDATA memory.

-D_XDATA_ROM_START=_XDATA_START	// First address of on chip XDATA_ROM_C memory.
-D_XDATA_ROM_END=_XDATA_END		// Last address of on chip XDATA_ROM_C memory.

-D_XDATA_HEAP_SIZE=100
-D_XDATA_HEAP_START=8100
-D_XDATA_HEAP_END=_XDATA_END


// CODE Segment definition.
-D_VECTOR_START=0
-D_BOOT_CODE_START=200		// First address for boot code.(16-Kbytes)
-D_BOOT_CODE_END=2200		// First address for boot code.(16-Kbytes)
-D_CODE_START=_BOOT_CODE_END	// First address for code.(16-Kbytes)
-D_CODE_END=FFFF			// Last address for code.(16-Kbytes)

-D_ISR_START=2260		// address = 0x2260
-D_ISR_END=_CODE_END

-D_USB_EVENT_START=2C61	// address = 0x2C61
-D_USB_EVENT_END=_CODE_END

-D_TABLE_START=3000	// address = 0x3000
-D_TABLE_END=_CODE_END

-D_FAR_CODE_START=_CODE_START
-D_FAR_CODE_END=_CODE_END

-D_HUGE_CODE_START=_CODE_START
-D_HUGE_CODE_END=_CODE_END

-D_BANK_RELAYS_START=_CODE_START
-D_BANK_RELAYS_END=_CODE_END
-D_FIRST_BANK_ADDR=10000

// add for testing banked mode code.
//-D_BANK_TEST_START=18000	// address = 0x18000
//-D_BANK_TEST_END=FFFFF

// Chip mode controlers
// --------------------
//-D?ACON=9D

// Extended stack
// --------------
//-D?ESP=9B
//-P(XDATA)MYDATA=8000-8FFF

// 
//    CODE bank setup
// 
-D_NR_OF_BANKS=0x10
// ?CBANK_MASK specifies which bits in the ?CBANK register that controls the
// active bank. If the value is changed, change the value to the suffix of the
// directives -e?BCALL_XX=BCALL, -e?BRET_XX=BRET and -e?BDISPATCH_XX=BDISPATCH
// to have the same XX value. 
-D?CBANK_MASK=0xFF
-e?BCALL_FF=?BCALL
-e?BRET_FF=?BRET
-e?BDISPATCH_FF=?BDISPATCH

//---------------------------------------------------------------------------------

////////////////////////////////////////////////////////////////////////////////
//
// This is a XLINK command file.
//
//
//   Revision control system
////////////////////////////////////////////////////////////////////////////////

//
// Variables (used below)
//

-D?REGISTER_BANK=0        // Default register bank (0,1,2,3).
-D_REGISTER_BANK_START=0  // Start address for default register bank (00,08,10,18).
-Z(DATA)REGISTERS+8=_REGISTER_BANK_START

//
// PDATA page setup
//
-D?PBANK_NUMBER=80		// high byte of 16-bit address to the PDATA area
-D?PBANK=A0               // Most significant byte in MOVX A,@R0. (0xA0 is sfr P2)

//
// Virtual register setup
//
-Z(DATA)VREG+_NR_OF_VIRTUAL_REGISTERS=08-7F

// located of the virtual bit register in the linker command.(0x20-0x2F)
-D?VB=20                  // ?VB is used when referencing BREG as whole byte.
					// Must be placed on : ?VB=0x20+_BREG_START/8
-Z(BIT)BREG=_BIT_START-_BIT_END

// Stack pointer to the stack in PDATA memory
-Z(DATA)PSP=18

// Stack pointer to the stack in PDATA memory
-Z(DATA)XSP=18-19

// See configuration section concerning printf/sprintf and scanf/sscanf to see
// how you can configure _formatted_write and _formatted_read routines.
//-e_medium_write=_formatted_write
//-e_medium_read=_formatted_read

////////////////////////////////////////////////////////////////////////////////
//
// RAM memory
//

// Setup "bit" segments (only for '__no_init bool' variables).
-Z(BIT)BIT_N=_BIT_START-_BIT_END		// holds __no_init __bit static and global veriable.

// Setup "bdata" segments
-Z(DATA)BDATA_I,BDATA_Z,BDATA_N=_BDATA_START-_BDATA_END	// holds __bdata variable.

// Setup "data" segments
-Z(DATA)DATA_I,DATA_Z,DATA_N#_DATA_START-_DATA_END	// holds __data variable.
-Z(DATA)DOVERLAY=_DATA_START-_DATA_END		// holds the static overlay area.

// Setup "istack" and "idata" segments
-Z(IDATA)ISTACK+_IDATA_STACK_SIZE=_IDATA_START-_IDATA_END	// 0x30 ~ 0xFF
-Z(IDATA)IDATA_I,IDATA_Z,IDATA_N#_IDATA_START-_IDATA_END
-Z(IDATA)IOVERLAY=_IDATA_START-_IDATA_END				// IDATA Overlay Area.

//
// Stacks located in XDATA
//
//
// PDATA - data memory
//
-Z(XDATA)PSTACK+_PDATA_STACK_SIZE#_PDATA_START-_PDATA_END	// 0x8000 ~ 0x80FF
-Z(XDATA)PDATA_N,PDATA_Z,PDATA_I=_PDATA_START-_PDATA_END	// 0x8000 ~ 0x80FF

//
// XDATA - data memory
//
//-Z(XDATA)EXT_STACK+_EXTENDED_STACK_SIZE=_EXTENDED_STACK_START-_EXTENDED_STACK_END
-Z(XDATA)XSTACK+_XDATA_STACK_SIZE#_XDATA_START-_XDATA_END	// 0x8100 ~ 0x82FF
-Z(XDATA)IXDATA_N,IXDATA_Z,IXDATA_I=_IXDATA_START-_IXDATA_END	// 0x8100 ~ 0x82FF
-Z(XDATA)XDATA_N,XDATA_Z,XDATA_I=_XDATA_START-_XDATA_END		// 0x8100 ~ 0x82FF
-Z(XDATA)XDATA_HEAP+_XDATA_HEAP_SIZE=_XDATA_HEAP_START-_XDATA_HEAP_END

// initialized FAR data
// Note: The segment FAR_I and FAR_ID must start at the same address within a 64k bank,
// they must therefore be located first in the FAR data area, and in the xlink linker file
// Note: *_I segment is located in RAM but *_ID segments is located in ROM
//
// FAR - extended data memory
//
-Z(XDATA)FAR_N,FAR_Z,FAR_I=_XDATA_START-_XDATA_END
-Z(CONST)FAR_ROM_C=_XDATA_START-_XDATA_END
-Z(CONST)FAR_ROM_AC=_XDATA_START-_XDATA_END

//
// HUGE - extended data memory
//
-Z(XDATA)HUGE_N,HUGE_Z,HUGE_I=_XDATA_START-_XDATA_END
-Z(CONST)HUGE_ROM_C=_XDATA_START-_XDATA_END
-Z(CONST)HUGE_ROM_AC=_XDATA_START-_XDATA_END



////////////////////////////////////////////////////////////////////////////////
//
// ROM memory
//
// Note: INTVEC must be placed first.
// Note: CSTART Must be located in first 64k.
-Z(CODE)INTVEC=_VECTOR_START
-Z(CODE)SBL_SEG=_BOOT_CODE_START-_CODE_START
-Z(CODE)CSTART=_CODE_START-_CODE_END

-Z(CODE)ISR_SEG=_ISR_START-_ISR_END // PROGRAM_START+60
-Z(CODE)USB_EVEN_SEG=_USB_EVENT_START-_USB_EVENT_END // PROGRAM_START+601
-Z(CODE)TABLE_SEG=_TABLE_START-_TABLE_END //JHKIM ADD FOR brjpeg
//-Z(CODE)BANK_TEST_SEG=_BANK_TEST_START-_BANK_TEST_END // add for testing banked mode

//
// Constants located in code memory
//
-Z(CONST)XDATA_ROM_C=_CODE_START-_CODE_END			// unused.
-Z(CONST)XDATA_ROM_AC=_CODE_START-_CODE_END			// unused.
-Z(CODE)CODE_N=_CODE_START-_CODE_END				// __no_init __code static and global variable.
-Z(CODE)CODE_C=_CODE_START-_CODE_END				// __code constant data.
-Z(CODE)CODE_AC=_CODE_START-_CODE_END				// __code located constant data.
-Z(CODE)FAR_CODE_C=_FAR_CODE_START-_FAR_CODE_END		// unused, __far_code constant data.
-Z(CODE)FAR_CODE_AC=_FAR_CODE_START-_FAR_CODE_END		// unused, __far_code located constant data.
-Z(CODE)HUGE_CODE_C=_HUGE_CODE_START-_HUGE_CODE_END	// unused, __huge_code constant data.
-Z(CODE)HUGE_CODE_AC=_HUGE_CODE_START-_HUGE_CODE_END	// unused, __huge_code located constant data.

//
// Initializers
//
-Z(CODE)BIT_ID,BDATA_ID,DATA_ID,IDATA_ID,IXDATA_ID,PDATA_ID,XDATA_ID=_CODE_START-_CODE_END
-Z(CODE)FAR_ID=_FAR_CODE_START-_FAR_CODE_END
-Z(CODE)HUGE_ID=_HUGE_CODE_START-_HUGE_CODE_END

//
// Program memory
//
-Z(CODE)TINY_CODE=_CODE_START-_CODE_END
-Z(CODE)NEAR_CODE=_CODE_START-_CODE_END
-Z(CODE)RCODE=_CODE_START-_CODE_END
-Z(CODE)FAR_CODE=_CODE_START-_CODE_END
-Z(CODE)HUGE_CODE=_CODE_START-_CODE_END
// Setup bank-switched segments.
-Z(CODE)BANK_RELAYS=_BANK_RELAYS_START-_BANK_RELAYS_END
-P(CODE)BANKED_CODE=[_CODEBANK_START-_CODEBANK_END]*_NR_OF_BANKS+_FIRST_BANK_ADDR


-cx51 -za
